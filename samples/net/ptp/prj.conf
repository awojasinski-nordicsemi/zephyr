## CMakeLists.txt
```
# SPDX-License-Identifier: Apache-2.0

cmake_minimum_required(VERSION 3.20.0)

find_package(Zephyr REQUIRED HINTS $ENV{ZEPHYR_BASE})
project(ptp)

target_sources(app PRIVATE src/main.c)
```

## sample.yaml
```
common:
  harness: net
  tags:
    - net
    - ptp
sample:
  description: Test PTP functionality
  name: PTP sample app
tests:
  sample.net.ptp:
    platform_allow:
      - native_posix
      - native_posix/native/64
      - native_sim
      - native_sim/native/64
      - nucleo_f767zi
      - nucleo_h743zi
      - nucleo_h745zi_q/stm32h745xx/m7
      - nucleo_h563zi
      - qemu_cortex_a53
      - qemu_x86
      - qemu_x86_64
    depends_on: eth
    integration_platforms:
      - nucleo_h563zi
      - qemu_cortex_a53
      - qemu_x86
```

## prj.conf
```kconfig
CONFIG_NETWORKING=y
CONFIG_LOG=y
CONFIG_LOG_MODE_DEFERRED=y
CONFIG_PRINTK=y

CONFIG_NET_LOG=y
CONFIG_NET_SHELL=Y
CONFIG_NET_IPV4=y
CONFIG_NET_DHCPV4=y
CONFIG_NET_UDP=y
CONFIG_NET_L2_ETHERNET=y
CONFIG_NET_STATISTICS=y
CONFIG_NET_STATISTICS_USER_API=y
CONFIG_NET_CONFIG_SETTINGS=y
CONFIG_NET_CONFIG_NEED_IPV4=y
CONFIG_NET_CONFIG_MY_IPV4_ADDR="192.0.2.1"
CONFIG_NET_CONFIG_MY_IPV4_NETMASK="255.255.255.0"
CONFIG_NET_IF_MCAST_IPV4_ADDR_COUNT=3

CONFIG_PTP=y
CONFIG_PTP_STATISTICS=y
CONFIG_PTP_LOG_LEVEL_DBG=y
CONFIG_PTP_CLOCK=y
```

## src/main.c
```c
/*
 * Copyright (c) 2024 BayLibre SAS.
 *
 * SPDX-License-Identifier: Apache-2.0
 */

#include <zephyr/logging/log.h>
LOG_MODULE_REGISTER(net_ptp_sample, LOG_LEVEL_DBG);

#include <zephyr/kernel.h>
#include <errno.h>

int main(void)
{
	return 0;
}
```
