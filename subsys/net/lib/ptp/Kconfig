## subsys/net/lib/ptp/Kconfig
```kconfig
menuconfig PTP
	bool "IEEE 1588 (PTP) support [EXPERIMENTAL]"
	select EXPERIMENTAL
	select NET_SOCKETS
	select NET_L2_PTP
	depends on NET_L2_ETHERNET
	help
	  Enable PTP Stack that send and receives PTP packets
	  and handles network packet timestamps. The protocol's implementation
	  supports only one PTP Instance in the PTP Node.

if PTP

module = PTP
module-dep = NET_LOG
module-str = Log level for PTP
module-help = Enable logs for the PTP stack.
source "subsys/net/Kconfig.template.log_config.net"

choice
	prompt "PTP Clock Type"
	default PTP_ORDINARY_CLOCK
	help
	  Specifies type of PTP Clock implemented on the target device

	config PTP_ORDINARY_CLOCK
		bool "Ordinary Clock"

	config PTP_BOUNDARY_CLOCK
		bool "Boundary Clock"

	config PTP_TRANSPARENT_P2P_CLOCK
		bool "Transparent Peer-to-Peer Clock"

	config PTP_TRANSPARENT_E2E_CLOCK
		bool "Transparent End-to-End Clock"
endchoice

config PTP_CLOCK_TYPE
	hex
	default 0x00 if PTP_ORDINARY_CLOCK
	default 0x01 if PTP_BOUNDARY_CLOCK
	default 0x02 if PTP_TRANSPARENT_P2P_CLOCK
	default 0x03 if PTP_TRANSPARENT_E2E_CLOCK

choice
	prompt "PTP Networking Protocol used by PTP Stack"
	default PTP_UDP_IPv4_PROTOCOL

	config PTP_UDP_IPv4_PROTOCOL
		bool "UDP with IPv4"

	config PTP_UDP_IPv6_PROTOCOL
		bool "UDP with IPv6"

	config PTP_IEEE_802_3_PROTOCOL
		bool "IEEE 802.3 - Raw Ethernet packets"
endchoice

config PTP_NET_PROTOCOL
	hex
	default 0x01 if PTP_UDP_IPv4_PROTOCOL
	default 0x02 if PTP_UDP_IPv6_PROTOCOL
	default 0x03 if PTP_IEEE_802_3_PROTOCOL

config PTP_NUM_PORTS
	int "Number of PTP Ports"
	default 1 if PTP_ORDINARY_CLOCK
	default 2 if PTP_BOUNDARY_CLOCK || PTP_TRANSPARENT_P2P_CLOCK || PTP_TRANSPARENT_E2E_CLOCK
	range 1 32 if PTP_ORDINARY_CLOCK
	range 2 32 if PTP_BOUNDARY_CLOCK || PTP_TRANSPARENT_P2P_CLOCK || PTP_TRANSPARENT_E2E_CLOCK
	help
	  Configures the PTP stack to work with the given number of ports.
	  The port concept is the same thing as network interface.

choice
	prompt "PTP Clock Accuracy"
	default PTP_CLOCK_ACCURACY_UNKNOWN
	help
	  Specify the accuracy of the clock. This setting should reflect
	  the actual capabilities of the hardware.
	  See 7.6.2.5 of IEEE 1588-2019 for more info.

	config PTP_CLOCK_ACCURACY_UNKNOWN
		bool "Unknown"
	config PTP_CLOCK_ACCURACY_25NS
		bool "25ns"
	config PTP_CLOCK_ACCURACY_100NS
		bool "100ns"
	config PTP_CLOCK_ACCURACY_250NS
		bool "250ns"
	config PTP_CLOCK_ACCURACY_1US
		bool "1us"
	config PTP_CLOCK_ACCURACY_2_5US
		bool "2.5us"
	config PTP_CLOCK_ACCURACY_10US
		bool "10us"
	config PTP_CLOCK_ACCURACY_25US
		bool "25us"
	config PTP_CLOCK_ACCURACY_100US
		bool "100us"
	config PTP_CLOCK_ACCURACY_250US
		bool "250us"
	config PTP_CLOCK_ACCURACY_1MS
		bool "1ms"
	config PTP_CLOCK_ACCURACY_2_5MS
		bool "1.5ms"
	config PTP_CLOCK_ACCURACY_10MS
		bool "10ms"
	config PTP_CLOCK_ACCURACY_25MS
		bool "25ms"
	config PTP_CLOCK_ACCURACY_100MS
		bool "100ms"
	config PTP_CLOCK_ACCURACY_250MS
		bool "250ms"
	config PTP_CLOCK_ACCURACY_1S
		bool "1s"
	config PTP_CLOCK_ACCURACY_10S
		bool "10s"
	config PTP_CLOCK_ACCURACY_GT_10S
		bool "> 10s"
endchoice

config PTP_CLOCK_ACCURACY
	hex
	default 0x20 if PTP_CLOCK_ACCURACY_25NS
	default 0x21 if PTP_CLOCK_ACCURACY_100NS
	default 0x22 if PTP_CLOCK_ACCURACY_250NS
	default 0x23 if PTP_CLOCK_ACCURACY_1US
	default 0x24 if PTP_CLOCK_ACCURACY_2_5US
	default 0x25 if PTP_CLOCK_ACCURACY_10US
	default 0x26 if PTP_CLOCK_ACCURACY_25US
	default 0x27 if PTP_CLOCK_ACCURACY_100US
	default 0x28 if PTP_CLOCK_ACCURACY_250US
	default 0x29 if PTP_CLOCK_ACCURACY_1MS
	default 0x2a if PTP_CLOCK_ACCURACY_2_5MS
	default 0x2b if PTP_CLOCK_ACCURACY_10MS
	default 0x2c if PTP_CLOCK_ACCURACY_25MS
	default 0x2d if PTP_CLOCK_ACCURACY_100MS
	default 0x2e if PTP_CLOCK_ACCURACY_250MS
	default 0x2f if PTP_CLOCK_ACCURACY_1S
	default 0x30 if PTP_CLOCK_ACCURACY_10S
	default 0x31 if PTP_CLOCK_ACCURACY_GT_10S
	default 0xfe

choice
	prompt "PTP Profile"
	default PTP_PROFILE_DEFAULT_E2E
	help
	  Specify the profile of the PTP stack. This setting should reflect
	  the system's needs. See xxx of IEEE 1588-2019 for more info.

	config PTP_PROFILE_DEFAULT_E2E
		bool "Default Delay Request-Response"
		help

	config PTP_PROFILE_DEFAULT_P2P
		bool "Default Peer-to-Peer"
		help

	config PTP_PROFILE_HIGH_ACCURACY
		bool "High Accuracy Default Request-Response"
		help

	config PTP_PROFILE_IEEE_802_1AS
		bool "IEEE Std 802.1AS"
		help
		  Better known as gPTP (generic PTP) Protocol
endchoice

choice
	prompt "PTP Delay Mechanism"
	default PTP_DELAY_MECHANISM_E2E

	config PTP_DELAY_MECHANISM_E2E
		bool "End-to-End delay mechanism"

	config PTP_DELAY_MECHANISM_P2P
		bool "Peer-to-Peer delay mechanism"

	config PTP_DELAY_MECHANISM_COMMON_P2P
		bool "Peer-to-Peer Common Mean delay mechanism"

	config PTP_DELAY_MECHANISM_SPECIAL
		bool "Special delay mechanism"
endchoice

config PTP_DELAY_MECHANISM
	hex "Delay mechanism used in PTP Domain"
	default 0x1 if CONFIG_PTP_DELAY_MECHANISM_E2E
	default 0x2 if CONFIG_PTP_DELAY_MECHANISM_P2P
	default 0x3 if CONFIG_PTP_DELAY_MECHANISM_COMMON_P2P
	default 0x4 if CONFIG_PTP_DELAY_MECHANISM_SPECIAL
	default 0xFE

config PTP_STACK_SIZE
	int "PTP thread stack size"
	default 2048
	help
	  Set the PTP thread stack size in bytes. The PTP thread handles the
	  PTP state machine. There is one PTP thread in the system.

config PTP_MSG_POLL_SIZE
	int "Number of messages available for allocation"
	default 10
	help
	  PTP messages are allocated dynamically from memory slab. The Kconfig symbol
	  defines number of blocks in the memory slab.

config PTP_DISABLED_PRESENT
	bool "The DISABLED state is present"
	default true

config PTP_FAULTY_PRESENT
	bool "The FAULTY state is present"
	default true

config PTP_LISTENING_PRESENT
	bool "The LISTENING state is present"
	default true

config PTP_PRE_MASTER_PESENT
	bool "The PRE-MASTER state is present"
	default true

config PTP_UNCALIBRATED_PRESENT
	bool "The UNCALIBRATED state is present"
	default true

config PTP_FOREIGN_MASTER_FEATURE
	bool
	default true

config PTP_PRIORITY1
	int "Value used in the Best Master Clock Algorithm (BMCA)"
	default 128
	range 0 255

config PTP_PRIORITY2
	int "Value used in the Best Master Clock Algorithm (BMCA)"
	default 128
	range 0 255

config PTP_SLAVE_ONLY
	bool "Configure Clock as slaveOnly PTP Instance"
	depends on PTP_ORDINARY_CLOCK
	default false
	help
	  An Oridinary Clock may be designed to ba a slaveOnly PTP Instnace. In that state
	  the instance can never enter the MASTER state.

config PTP_FOREIGN_MASTER_LIST_SIZE
	int "Size of a foreignMasterList used in Best master clock algorithm"
	default 5
	range 5 32

config PTP_ANNOUNCE_RECV_TIMEOUT
	int "Number of announce intervals to wait"
	default 3
	range 2 255
	help
	  Defines the number of announce intervals to wait without receiving
	  an Announce message before assuming that the master is no longer
	  transmitting Announce messages and rising timeout event.

config PTP_ANNOUNCE_LOG_INTERVAL
	int "Interval between successive Announce messages"
	default 127
	help
	  Defines mean time interval between successive Announce messages. The value should be
	  uniform through PTP domain. For more check IEEE 1588-2019 Section 7.7.2.2.
	  The value is the converted to nanoseconds as follow: nanoseconds = (10^9) * 2^(value)

config PTP_MIN_DELAY_REQ_LOG_INTERVAL
	int "Interval between successive Delay_Req messages"
	default 0
	help
	  The minimum time interval between Delay_Req messages.
	  The value is the converted to nanoseconds as follow: nanoseconds = (10^9) * 2^(value)

config PTP_SYNC_LOG_INTERVAL
	int "Interval between successive Sync messages"
	default -3
	help
	  Specify mean time interval between successive Sync messages,
	  when transmitted as multicast messages. The value is the converted
	  to nanoseconds as follow: nanoseconds = (10^9) * 2^(value)

config PTP_MIN_PDELAY_REQ_LOG_INTERVAL
	int "PDelay Req interval in Log2 base"
	default 0
	help
	  Specifies minimum permitted mean time interval between successive Pdelay_Req messages.
	  The value is the converted to nanoseconds as follow: nanoseconds = (10^9) * 2^(value)

config PTP_STATISTICS
	bool "Collect PTP statistics"
	help
	  Collected measurements can be accessed through shell.

choice PTP_DSCP_PRIORITY
	prompt ""
	default PTP_DSCP_NONE_PRIORITY

	config PTP_DSCP_HIGH_PRIORITY
		bool "High priority of PTP packet classification"

	config PTP_DSCP_MEDIUM_PRIORITY
		bool "Medium priority of PTP packet classification"

	config PTP_DSCP_NONE_PRIORITY
		bool "Default priority of PTP packet classification"
endchoice

config PTP_DSCP_VALUE
	int "Value of PTP packetc classification"
	default 56 if PTP_DSCP_HIGH_PRIORITY
	default 46 if PTP_DSCP_MEDIUM_PRIORITY
	default 0 if PTP_DSCP_NONE_PRIORITY
	range 0 63

endif # PTP
```

## tests/kernel/mem_protect/demand_paging/boards/qemu_x86_tiny_custom_flash.conf
```kconfig
# Copyright (c) 2024 BayLibre SAS
# SPDX-License-Identifier: Apache-2.0

# The following is needed so that .text and following
# sections are present in physical memory to test
# using backing store for anonymous memory.
CONFIG_KERNEL_VM_BASE=0x0
CONFIG_LINKER_GENERIC_SECTIONS_PRESENT_AT_BOOT=y
CONFIG_BACKING_STORE_CUSTOM=y
CONFIG_FLASH=y
CONFIG_FLASH_SIMULATOR_EXPLICIT_ERASE=n
```

## tests/kernel/mem_protect/demand_paging/mem_map/testcase.yaml
```yaml
common:
  ignore_faults: true
tests:
  kernel.demand_paging:
    tags:
      - kernel
      - mmu
      - demand_paging
    platform_allow:
      - qemu_cortex_a53
      - qemu_x86_tiny
    extra_configs:
      - CONFIG_COMMON_LIBC_MALLOC_ARENA_SIZE=0
  kernel.demand_paging.custom_flash:
    platform_allow:
      - qemu_cortex_a53
      - qemu_x86_tiny
    extra_args:
      - DTC_OVERLAY_FILE='boards/custom_flash.overlay'
    extra_configs:
      - CONFIG_COMMON_LIBC_MALLOC_ARENA_SIZE=0
      - CONFIG_BACKING_STORE_CUSTOM=y
      - CONFIG_FLASH=y
  kernel.demand_paging.timing_funcs:
    tags:
      - kernel
      - mmu
      - demand_paging
    platform_allow: qemu_x86_tiny
    extra_configs:
      - CONFIG_DEMAND_PAGING_STATS_USING_TIMING_FUNCTIONS=y
      - CONFIG_COMMON_LIBC_MALLOC_ARENA_SIZE=0
```

## tests/kernel/mem_protect/demand_paging/testcase.yaml
```yaml
common:
  ignore_faults: true
tests:
  kernel.demand_paging:
    tags:
      - kernel
      - mmu
      - demand_paging
    platform_allow: qemu_x86_tiny
    extra_configs:
      - CONFIG_COMMON_LIBC_MALLOC_ARENA_SIZE=0
  kernel.demand_paging.custom_flash:
    platform_allow: qemu_x86_tiny
    extra_args:
      - OVERLAY_CONFIG="boards/qemu_x86_tiny_custom_flash.conf"
      - DTC_OVERLAY_FILE='boards/qemu_x86_tiny_custom_flash.overlay'
    extra_configs:
      - CONFIG_COMMON_LIBC_MALLOC_ARENA_SIZE=0
  kernel.demand_paging.timing_funcs:
    tags:
      - kernel
      - mmu
      - demand_paging
    platform_allow: qemu_x86_tiny
    extra_configs:
      - CONFIG_DEMAND_PAGING_STATS_USING_TIMING_FUNCTIONS=y
      - CONFIG_COMMON_LIBC_MALLOC_ARENA_SIZE=0
```
